## conf/distro/aesys-distro.conf
```bitbake
# Aesys DISTRO based on fsl-imx-wayland
include conf/distro/fslc-x11.conf

DISTRO = "aesys-distro"
DISTRO_NAME = "Aesys Linux"
DISTRO_VERSION = "1.0"
DISTRO_CODENAME = "aesys-distro"

# Remove vulkan from DISTRO_FEATURES
DISTRO_FEATURES:remove = "vulkan"
```

## conf/layer.conf
```bitbake
# We have a conf and classes directory, add to BBPATH
BBPATH .= ":${LAYERDIR}"

# We have recipes-* directories, add to BBFILES
BBFILES += "${LAYERDIR}/recipes-*/*/*.bb \
            ${LAYERDIR}/recipes-*/*/*.bbappend"

BBFILE_COLLECTIONS += "meta-variscite-aesys"
BBFILE_PATTERN_meta-variscite-aesys = "^${LAYERDIR}/"
BBFILE_PRIORITY_meta-variscite-aesys = "10"

LAYERDEPENDS_meta-variscite-aesys = "core"
LAYERSERIES_COMPAT_meta-variscite-aesys = "kirkstone"
```
